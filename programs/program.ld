ENTRY(_start)

SECTIONS
{
    . = 0x00200000;

    .text : {
        KEEP(*(.text.entry))
        *(.text)
        *(.text.*)
    }

    .rodata : {
        *(.rodata)
        *(.rodata.*)
    }

    .data : {
        *(.data)
        *(.data.*)
    }

    .bss : {
        *(.bss)
        *(.bss.*)
        *(COMMON)
    }
}
